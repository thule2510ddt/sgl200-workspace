## firmware/Kconfig
```kconfig
source "Kconfig.zephyr"

rsource "drivers/Kconfig"

menu "SGL-200 Application Options"

config SGL200
    bool "Enable SGL-200 application"
    default y

config SGL200_ACTUATOR_SERVO_PWM
    bool "Servo PWM actuator backend"
    default y
    depends on SGL200
    depends on PWM
    help
      Use TIM4_CH1 PB6 for pitch and TIM4_CH2 PB7 for yaw servo PWM.

endmenu
```

## firmware/boards/arm/sgl200_v1/Kconfig.defconfig
```kconfig
if BOARD_SGL200_V1

config GPIO
	default y

config BOARD
	default "sgl200_v1"

config SERIAL
	default y

config SPI
	default y

endif
```

## firmware/boards/arm/sgl200_v1/sgl200_v1_defconfig
```kconfig
CONFIG_SOC_SERIES_STM32G4X=y
CONFIG_SOC_STM32G431XX=y
CONFIG_GPIO=y
CONFIG_SERIAL=y
CONFIG_SPI=y
```

## firmware/drivers/feetech/Kconfig
```kconfig
config SGL200_FEETECH
	bool "Feetech ST3215HS servo driver"
	depends on SERIAL
	default n
```

## firmware/drivers/icm42688/Kconfig
```kconfig
config SGL200_ICM42688
	bool "ICM-42688-P SPI IMU driver"
	depends on SPI
	select GPIO
	default n
```

## firmware/dts/bindings/saolatek,icm42688.yaml
```yaml
description: Saolatek ICM-42688 SPI IMU

compatible: "saolatek,icm42688"

include: spi-device.yaml

properties:
  int-gpios:
    type: phandle-array
    required: true
    description: Data-ready interrupt GPIO, active high on SGL-200.
```

## firmware/west.yml
```yaml
manifest:
  version: "0.13"
  remotes:
    - name: zephyrproject
      url-base: https://github.com/zephyrproject-rtos
  projects:
    - name: zephyr
      remote: zephyrproject
      revision: v3.6.0
      import:
        path-prefix: modules
  self:
    path: firmware
```
